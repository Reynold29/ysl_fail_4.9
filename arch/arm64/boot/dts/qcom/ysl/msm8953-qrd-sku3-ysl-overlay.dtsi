#include "msm-audio-ysl.dtsi"
#include "msm8953-pinctrl-ysl.dtsi"
#include "msm8953-audio-ysl.dtsi"
#include "msm8953-camera-sensor-qrd-ysl.dtsi"
#include"dsi-panel-shenchao-ili9881c-720p-video.dtsi"
#include "dsi-panel-auo-hd720-video.dtsi"
#include "dsi-panel-hx-otm1901a-720p-video.dtsi"
#include "msm8953-pm-ysl.dtsi"
#include "msm8953-regulator-ysl.dtsi"
#include"dsi-panel-shenchao-ili9881c-hd720-video.dtsi"
#include"dsi-panel-truly-hd720-video.dtsi"
#include"msm8953-cdp-ysl.dtsi"
#include"msm-pm8953-ysl.dtsi"